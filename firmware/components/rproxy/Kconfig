## firmware/components/rproxy/Kconfig
```kconfig
menu "Reverse exit-node dialer (rproxy)"

config RPROXY_DEFAULT_ENABLED
    bool "Enable rproxy automatically on first boot"
    default n
    help
        When set, a freshly flashed device starts the pool as soon as the STA
        uplink has an IP, using the defaults below (unless NVS already holds a
        configuration). Used for zero-touch provisioning.

config RPROXY_DEFAULT_HOST
    string "Default broker host"
    default ""

config RPROXY_DEFAULT_PORT
    int "Default broker port"
    default 7000

config RPROXY_DEFAULT_TOKEN
    string "Default pool token (baked into firmware)"
    default ""
    help
        Shared secret sent in HELLO. Baked in at build time so end users never
        have to type it. The device additionally identifies itself by MAC so
        individual devices can be blocked on the broker.

config RPROXY_DEFAULT_POOL
    int "Default pool size (1-8)"
    range 1 8
    default 4

config RPROXY_MAX_STREAMS
    int "Max concurrent customer streams on the mux link"
    range 1 48
    default 24 if SPIRAM
    default 6
    help
        Every stream holds a target socket and a RPROXY_MUX_WINDOW receive
        window (in PSRAM when available). Keep CONFIG_LWIP_MAX_SOCKETS at
        least this plus ~10 for the console, DNS and the broker link itself.

config RPROXY_MUX_WINDOW
    int "Per-stream receive window advertised to the broker (bytes)"
    range 4096 65536
    default 32768
    help
        Credit the node grants the broker per stream (broker -> node). Sent in
        HELLO as win=; a broker that predates the token assumes 32768, so only
        lower this with a broker from 2.4.22 on. A board without PSRAM uses
        8192. The node -> broker direction stays at the broker's 32 KB.

config RPROXY_MUX_FRAME
    int "Largest DATA payload accepted from the broker (bytes)"
    range 1024 16384
    default 16384
    help
        Sent in HELLO as frame=. Sizes the link receive buffer and the frame
        scratch buffer (2 x this + headers); also the largest frame the node
        sends. 4096 on a board without PSRAM.

config RPROXY_DIALERS
    int "Dialer tasks (parallel DNS + connect)"
    range 1 4
    default 4
    help
        Each dialer task costs RPROXY_DIALER_STACK bytes of RAM. One is enough
        for a few streams; four keep 40 streams dialing in parallel.

config RPROXY_DIALER_STACK
    int "Dialer task stack (bytes)"
    range 3072 8192
    default 4608

config RPROXY_DEFAULT_TLS
    bool "Use TLS for the broker link by default"
    default y
    help
        The broker certificate is verified against the CA embedded in the
        firmware (components/rproxy/broker_ca.pem). Hostname is not checked
        because the CA is private and only ever issues the broker certificate.

config RPROXY_OTA_DEADLINE_SEC
    int "Overall OTA deadline (seconds)"
    range 30 600
    default 180
    help
        Bound the complete OTA download with a monotonic deadline, separate
        from the 5-second network I/O timeout. Failure normally aborts the
        partial image and reconnects without rebooting. A blocking IDF call
        that exceeds this deadline plus 10 seconds triggers a safe restart.

config RPROXY_ENV_SENSOR
    bool "Report room temperature/pressure (BMP280/BME280) and chip temperature in STATS"
    default n
    help
        A low-priority task reads a BMP280 or BME280 on I2C (address 0x76 or
        0x77) and the chip's own temperature sensor every 30 s, and each STATS
        sample carries the fresh values (tempc= press= chiptempc=). Without a
        sensor wired the board reports only the chip temperature and looks for
        the sensor again every 5 minutes. Enabled for the S3 N16R8 build.

config RPROXY_ENV_SDA
    int "Room sensor I2C SDA GPIO"
    depends on RPROXY_ENV_SENSOR
    default 8
    help
        On an S3 N16R8 keep clear of GPIO 26-37 (flash and octal PSRAM) and the
        strapping pins 0, 3, 45 and 46.

config RPROXY_ENV_SCL
    int "Room sensor I2C SCL GPIO"
    depends on RPROXY_ENV_SENSOR
    default 9

config RPROXY_TEST_HEAPTRACE
    bool "Test builds only: trace the heap and dump freed records on corruption"
    default n
    help
        Needs HEAP_TRACING_STANDALONE (and on RISC-V ESP_SYSTEM_USE_FRAME_POINTER
        for call stacks) plus comprehensive heap poisoning. A task checks heap
        integrity five times a second and, on the first corruption, prints every
        freed allocation with its allocating and freeing callers, then aborts.

config RPROXY_TEST_HANG
    bool "Test builds only: hang the relay loop 60 s after the link comes up"
    default n
    help
        Proves on a board that the relay watchdog restarts it when the mux
        loop stops making passes. Never enable in a release image.

config RPROXY_MINIMAL_UI
    bool "Minimal exit-node web UI (hide Firewall/VPN/PCAP)"
    default n
    help
        Hides the Firewall, VPN and PCAP features from the web UI and does not
        start packet capture. Keeps the router focused on the exit-node role.

config RPROXY_AP_AUTO_OFF
    bool "Turn the local AP off once the STA uplink is up"
    default n
    help
        After the device has an STA IP the setup AP (ESP32_NAT_Router) is
        disabled. If the uplink stays down for RPROXY_AP_AUTO_OFF_GRACE seconds
        the AP is re-enabled so the device can always be reconfigured.

config RPROXY_AP_AUTO_OFF_GRACE
    int "Seconds without STA IP before the AP comes back"
    default 90
    depends on RPROXY_AP_AUTO_OFF

endmenu
```

## firmware/main/Kconfig.projbuild
```kconfig
menu "Example Configuration"

    config STORE_HISTORY
        bool "Store command history in flash"
        default y
        help
            Linenoise line editing library provides functions to save and load
            command history. If this option is enabled, initalizes a FAT filesystem
            and uses it to store command history.

endmenu

menu "NAT Router Uplink"

    choice UPLINK_TYPE
        prompt "Uplink interface"
        default WIFI_STA_UPLINK
        config WIFI_STA_UPLINK
            bool "WiFi STA"
        config ETH_UPLINK
            bool "Ethernet (LAN8720)"
    endchoice

    config ETH_MDC_GPIO
        int "ETH MDC GPIO"
        default 23
        depends on ETH_UPLINK

    config ETH_MDIO_GPIO
        int "ETH MDIO GPIO"
        default 18
        depends on ETH_UPLINK

    config ETH_PHY_ADDR
        int "ETH PHY address"
        default 1
        depends on ETH_UPLINK

    config ETH_PHY_POWER_GPIO
        int "ETH PHY power GPIO (-1 for none)"
        default 16
        depends on ETH_UPLINK

    config ETH_RMII_CLK_OUTPUT_GPIO
        int "RMII clock output GPIO (-1 = input from PHY)"
        default -1
        depends on ETH_UPLINK
        help
            Set to the GPIO number on which the ESP32 should generate the 50 MHz
            RMII reference clock (e.g. GPIO 17 for the Olimex ESP32-POE-ISO).
            Leave at -1 when the PHY provides the clock (e.g. WT32-ETH01).

endmenu

menu "MQTT Home Assistant"

    config MQTT_HOMEASSISTANT
        bool "Enable MQTT Home Assistant integration"
        default y
        help
            Publishes router telemetry to an MQTT broker with
            Home Assistant auto-discovery. Adds ~58 KB flash.
            RAM is only used when a broker is configured and enabled.

    config MQTT_HA_BUFFER_SIZE
        int "MQTT buffer size (bytes)"
        default 1024
        depends on MQTT_HOMEASSISTANT

    config MQTT_DEFAULT_INTERVAL
        int "Default publish interval (seconds)"
        default 30
        depends on MQTT_HOMEASSISTANT
        range 5 3600

endmenu

menu "Exit node build"

    # Every gate defaults to today's behaviour so the other upstream targets
    # build unchanged; firmware/sdkconfig.defaults.exitnode flips them for the
    # exit-node boards (ESP32-S3 N16R8, ESP32-C3 Super Mini).

    config FEATURE_OLED
        bool "Build the OLED status display driver and set_oled commands"
        default y

    config FEATURE_PCAP
        bool "Build PCAP packet capture (TCP 19000, pcap command, web settings)"
        default y
        help
            An exit node must not capture customer traffic, and the capture
            hooks sit on the packet path; exit-node builds turn this off.

    config FEATURE_MDNS
        bool "Build the mDNS responder (<hostname>.local)"
        default y
        depends on !IDF_TARGET_ESP32C5
        help
            Disabled on ESP32-C5 to keep the image inside the app partition,
            and in exit-node builds to save RAM (nothing resolves the name).

    config WEB_SETUP_PORTAL_ONLY
        bool "Web UI is only the WiFi setup portal, alive while the setup AP is up"
        default n
        help
            Registers just the Getting Started page (/, /setup, /scan) and
            stops the HTTP server and captive DNS once the uplink is up (the
            rproxy AP policy restarts them when the AP comes back). The
            management pages (config, mappings, firewall, VPN, OTA upload,
            config import/export) are not built.

    config LED_GPIO_DEFAULT
        int "Status LED GPIO when NVS has no led_gpio (-1 = none)"
        default -1
        range -1 48

    config LED_LOWACTIVE_DEFAULT
        bool "Status LED is active-low when NVS has no led_lowactive"
        default n

endmenu
```
